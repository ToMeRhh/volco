#pragma once
// Loads firmware/test/golden/config.txt (shared with the C# tests; generated by
// firmware/tools/gen_config_vectors.py) for native tests.
#include <stdint.h>
#include <stdio.h>
#include <stdlib.h>
#include <string.h>
#include <string>
#include <vector>

struct ConfigCase {
  std::string kind, name;
  std::vector<uint8_t> blob;
  std::vector<std::string> rest;  // expectations after the hex
};

inline std::vector<ConfigCase> loadConfigCases() {
  std::string here = __FILE__;
  std::string dir = here.substr(0, here.find_last_of("/\\") + 1);
  FILE* f = fopen((dir + "golden/config.txt").c_str(), "r");
  if (!f) f = fopen("test/golden/config.txt", "r");
  std::vector<ConfigCase> out;
  if (!f) return out;
  static char line[8192];
  while (fgets(line, sizeof line, f)) {
    if (line[0] == '#' || line[0] == '\n' || line[0] == '\r') continue;
    ConfigCase c;
    char* tok = strtok(line, " \t\r\n");
    if (!tok) continue;
    c.kind = tok;
    c.name = strtok(nullptr, " \t\r\n");
    std::string hex = strtok(nullptr, " \t\r\n");
    if (hex != "-")
      for (size_t i = 0; i + 1 < hex.size(); i += 2) c.blob.push_back((uint8_t)strtoul(hex.substr(i, 2).c_str(), nullptr, 16));
    while ((tok = strtok(nullptr, " \t\r\n"))) c.rest.push_back(tok);
    out.push_back(c);
  }
  fclose(f);
  return out;
}

inline std::vector<ConfigCase> configCases(const char* kind) {
  static std::vector<ConfigCase> all = loadConfigCases();
  std::vector<ConfigCase> out;
  for (auto& c : all) if (c.kind == kind) out.push_back(c);
  return out;
}
